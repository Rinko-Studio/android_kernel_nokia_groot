&mdss_mdp {
	dsi_ili7807q_txd_fhd_video: qcom,mdss_dsi_ili7807q_txd_fhd_video {
		qcom,mdss-dsi-panel-name = "ili7807q_fhd_video_txd";
		qcom,mdss-dsi-panel-type = "dsi_video_mode";

		qcom,dsi-ctrl-num = <0>;
		qcom,dsi-phy-num = <0>;
		qcom,dsi-select-clocks = "mux_byte_clk0", "mux_pixel_clk0";

		qcom,mdss-dsi-virtual-channel-id = <0>;
		qcom,mdss-dsi-stream = <0>;
		qcom,mdss-dsi-h-left-border = <0>;
		qcom,mdss-dsi-h-right-border = <0>;
		qcom,mdss-dsi-v-top-border = <0>;
		qcom,mdss-dsi-v-bottom-border = <0>;
		qcom,mdss-dsi-bpp = <24>;
		qcom,mdss-dsi-color-order = "rgb_swap_rgb";
		qcom,mdss-dsi-underflow-color = <0xff>;
		qcom,mdss-dsi-border-color = <0>;
		qcom,mdss-dsi-h-sync-pulse = <0>;
		qcom,mdss-dsi-traffic-mode = "burst_mode";
		qcom,mdss-dsi-lane-map = "lane_map_0123";
		qcom,mdss-dsi-bllp-eof-power-mode;
		qcom,mdss-dsi-bllp-power-mode;
		qcom,mdss-dsi-tx-eot-append;
		qcom,mdss-dsi-lane-0-state;
		qcom,mdss-dsi-lane-1-state;
		qcom,mdss-dsi-lane-2-state;
		qcom,mdss-dsi-lane-3-state;
		qcom,mdss-dsi-dma-trigger = "trigger_sw";
		qcom,mdss-dsi-mdp-trigger = "none";
		qcom,mdss-dsi-bl-pmic-control-type = "bl_ctrl_wled";
                qcom,bl-update-flag = "delay_until_first_frame";
		qcom,mdss-dsi-reset-sequence = <1 5>, <0 5>, <1 5>;
		//qcom,mdss-pan-physical-width-dimension = <71>;
		//qcom,mdss-pan-physical-height-dimension = <158>;
		qcom,mdss-dsi-dma-schedule-line = <1>;

		qcom,mdss-dsi-display-timings {
			timing@0 {
				qcom,mdss-dsi-panel-width = <1080>;
				qcom,mdss-dsi-panel-height = <2400>;
				qcom,mdss-dsi-h-front-porch = <48>;
				qcom,mdss-dsi-h-back-porch = <12>;
				qcom,mdss-dsi-h-pulse-width = <32>;
				qcom,mdss-dsi-h-sync-skew = <0>;
				qcom,mdss-dsi-v-back-porch = <14>;
				qcom,mdss-dsi-v-front-porch = <34>;
				qcom,mdss-dsi-v-pulse-width = <8>;
				qcom,mdss-dsi-panel-framerate = <60>;

				qcom,mdss-dsi-on-command = [
					//29 01 00 00 01 00 14 f4 ff ff ff 04 00 c0 f0 01 00 00 00 00 00 c0 f0 39 c1 01 02
					//29 01 00 00 0a 00 14 f4 ff ff ff 68 00 00 f0 02 00 00 00 68 00 00 f0 00 00 00 00
					39 01 00 00 00 00 04 FF 78 07 06
					15 01 00 00 00 00 02 1F 0C
					39 01 00 00 00 00 04 FF 78 07 00
					05 01 00 00 05 00 02 01 00
					05 01 00 00 05 00 02 01 00
					39 01 00 00 00 00 04 FF 78 07 0B
					15 01 00 00 00 00 02 80 01
					39 01 00 00 00 00 04 FF 78 07 00
					05 01 00 00 05 00 02 01 00
					39 01 00 00 00 00 04 FF 78 07 01
					39 01 00 00 00 00 02 00 63
					15 01 00 00 00 00 02 01 E2
					15 01 00 00 00 00 02 02 34
					15 01 00 00 00 00 02 03 1F
					15 01 00 00 00 00 02 04 23
					15 01 00 00 00 00 02 05 42
					15 01 00 00 00 00 02 06 00
					15 01 00 00 00 00 02 07 00
					15 01 00 00 00 00 02 08 A3
					15 01 00 00 00 00 02 09 04
					15 01 00 00 00 00 02 0A 30
					15 01 00 00 00 00 02 0B 01
					15 01 00 00 00 00 02 0C 00
					15 01 00 00 00 00 02 0E 5A
					15 01 00 00 00 00 02 31 07
					15 01 00 00 00 00 02 32 07
					15 01 00 00 00 00 02 33 07
					15 01 00 00 00 00 02 34 3D
					15 01 00 00 00 00 02 35 3D
					15 01 00 00 00 00 02 36 02
					15 01 00 00 00 00 02 37 2E
					15 01 00 00 00 00 02 38 2F
					15 01 00 00 00 00 02 39 30
					15 01 00 00 00 00 02 3A 31
					15 01 00 00 00 00 02 3B 32
					15 01 00 00 00 00 02 3C 33
					15 01 00 00 00 00 02 3D 01
					15 01 00 00 00 00 02 3E 3C
					15 01 00 00 00 00 02 3F 11
					15 01 00 00 00 00 02 40 11
					15 01 00 00 00 00 02 41 13
					15 01 00 00 00 00 02 42 13
					15 01 00 00 00 00 02 43 3C
					15 01 00 00 00 00 02 44 08
					15 01 00 00 00 00 02 45 0C
					15 01 00 00 00 00 02 46 2C
					15 01 00 00 00 00 02 47 28
					15 01 00 00 00 00 02 48 28
					15 01 00 00 00 00 02 49 07
					15 01 00 00 00 00 02 4A 07
					15 01 00 00 00 00 02 4B 07
					15 01 00 00 00 00 02 4C 3D
					15 01 00 00 00 00 02 4D 3D
					15 01 00 00 00 00 02 4E 02
					15 01 00 00 00 00 02 4F 2E
					15 01 00 00 00 00 02 50 2F
					15 01 00 00 00 00 02 51 30
					15 01 00 00 00 00 02 52 31
					15 01 00 00 00 00 02 53 32
					15 01 00 00 00 00 02 54 33
					15 01 00 00 00 00 02 55 01
					15 01 00 00 00 00 02 56 3C
					15 01 00 00 00 00 02 57 10
					15 01 00 00 00 00 02 58 10
					15 01 00 00 00 00 02 59 12
					15 01 00 00 00 00 02 5A 12
					15 01 00 00 00 00 02 5B 3C
					15 01 00 00 00 00 02 5C 08
					15 01 00 00 00 00 02 5D 0C
					15 01 00 00 00 00 02 5E 2C
					15 01 00 00 00 00 02 5F 28
					15 01 00 00 00 00 02 60 28
					15 01 00 00 00 00 02 61 07
					15 01 00 00 00 00 02 62 07
					15 01 00 00 00 00 02 63 07
					15 01 00 00 00 00 02 64 3D
					15 01 00 00 00 00 02 65 3D
					15 01 00 00 00 00 02 66 28
					15 01 00 00 00 00 02 67 2E
					15 01 00 00 00 00 02 68 2F
					15 01 00 00 00 00 02 69 30
					15 01 00 00 00 00 02 6A 31
					15 01 00 00 00 00 02 6B 32
					15 01 00 00 00 00 02 6C 33
					15 01 00 00 00 00 02 6D 3C
					15 01 00 00 00 00 02 6E 00
					15 01 00 00 00 00 02 6F 12
					15 01 00 00 00 00 02 70 12
					15 01 00 00 00 00 02 71 10
					15 01 00 00 00 00 02 72 10
					15 01 00 00 00 00 02 73 3C
					15 01 00 00 00 00 02 74 0C
					15 01 00 00 00 00 02 75 08
					15 01 00 00 00 00 02 76 2C
					15 01 00 00 00 00 02 77 28
					15 01 00 00 00 00 02 78 28
					15 01 00 00 00 00 02 79 07
					15 01 00 00 00 00 02 7A 07
					15 01 00 00 00 00 02 7B 07
					15 01 00 00 00 00 02 7C 3D
					15 01 00 00 00 00 02 7D 3D
					15 01 00 00 00 00 02 7E 28
					15 01 00 00 00 00 02 7F 2E				
					15 01 00 00 00 00 02 80 2F
					15 01 00 00 00 00 02 81 30
					15 01 00 00 00 00 02 82 31
					15 01 00 00 00 00 02 83 32
					15 01 00 00 00 00 02 84 33
					15 01 00 00 00 00 02 85 3C
					15 01 00 00 00 00 02 86 00
					15 01 00 00 00 00 02 87 13
					15 01 00 00 00 00 02 88 13
					15 01 00 00 00 00 02 89 11
					15 01 00 00 00 00 02 8A 11
					15 01 00 00 00 00 02 8B 3C
					15 01 00 00 00 00 02 8C 0C
					15 01 00 00 00 00 02 8D 08
					15 01 00 00 00 00 02 8E 2C
					15 01 00 00 00 00 02 8F 28
					15 01 00 00 00 00 02 90 28
					15 01 00 00 00 00 02 91 E1
					15 01 00 00 00 00 02 92 19
					15 01 00 00 00 00 02 93 08
					15 01 00 00 00 00 02 94 00
					15 01 00 00 00 00 02 95 21
					15 01 00 00 00 00 02 96 19
					15 01 00 00 00 00 02 97 08
					15 01 00 00 00 00 02 98 00
					15 01 00 00 00 00 02 A0 83
					15 01 00 00 00 00 02 A1 44
					15 01 00 00 00 00 02 A2 83
					15 01 00 00 00 00 02 A3 44
					15 01 00 00 00 00 02 A4 61
					15 01 00 00 00 00 02 A5 00
					15 01 00 00 00 00 02 A6 15
					15 01 00 00 00 00 02 A7 50
					15 01 00 00 00 00 02 A8 1A
					15 01 00 00 00 00 02 B0 00
					15 01 00 00 00 00 02 B1 00
					15 01 00 00 00 00 02 B2 00
					15 01 00 00 00 00 02 B3 00
					15 01 00 00 00 00 02 B4 00
					15 01 00 00 00 00 02 C5 29
					15 01 00 00 00 00 02 C6 20
					15 01 00 00 00 00 02 C7 20
					15 01 00 00 00 00 02 C8 1F
					15 01 00 00 00 00 02 C9 00
					15 01 00 00 00 00 02 CA 01
					15 01 00 00 00 00 02 D1 11
					15 01 00 00 00 00 02 D2 00
					15 01 00 00 00 00 02 D3 01
					15 01 00 00 00 00 02 D4 00
					15 01 00 00 00 00 02 D5 00
					15 01 00 00 00 00 02 D6 3D
					15 01 00 00 00 00 02 D7 00
					15 01 00 00 00 00 02 D8 01
					15 01 00 00 00 00 02 D9 54
					15 01 00 00 00 00 02 DA 00
					15 01 00 00 00 00 02 DB 00
					15 01 00 00 00 00 02 DC 00
					15 01 00 00 00 00 02 DD 00
					15 01 00 00 00 00 02 DE 00
					15 01 00 00 00 00 02 DF 00
					15 01 00 00 00 00 02 E0 00
					15 01 00 00 00 00 02 E1 04
					15 01 00 00 00 00 02 E2 00
					15 01 00 00 00 00 02 E3 1B
					15 01 00 00 00 00 02 E4 52
					15 01 00 00 00 00 02 E5 49
					15 01 00 00 00 00 02 E6 34
					15 01 00 00 00 00 02 E7 00
					15 01 00 00 00 00 02 E8 01
					15 01 00 00 00 00 02 ED 55
					15 01 00 00 00 00 02 EF 30
					15 01 00 00 00 00 02 F0 00
					15 01 00 00 00 00 02 F4 54
					39 01 00 00 00 00 04 FF 78 07 02
					15 01 00 00 00 00 02 01 7D
					15 01 00 00 00 00 02 06 6B
					15 01 00 00 00 00 02 08 00
					15 01 00 00 00 00 02 0E 12
					15 01 00 00 00 00 02 0F 24
					15 01 00 00 00 00 02 40 00
					15 01 00 00 00 00 02 41 00
					15 01 00 00 00 00 02 42 09
					15 01 00 00 00 00 02 43 17
					15 01 00 00 00 00 02 46 32
					15 01 00 00 00 00 02 4D 02
					15 01 00 00 00 00 02 47 06
					15 01 00 00 00 00 02 53 04
					15 01 00 00 00 00 02 54 05
					15 01 00 00 00 00 02 56 02
					15 01 00 00 00 00 02 5D 07
					15 01 00 00 00 00 02 5E C0
					15 01 00 00 00 00 02 F4 00
					15 01 00 00 00 00 02 F5 00
					15 01 00 00 00 00 02 F6 00
					15 01 00 00 00 00 02 F7 00
					39 01 00 00 00 00 04 FF 78 07 04
					15 01 00 00 00 00 02 B7 45
					39 01 00 00 00 00 04 FF 78 07 05
					15 01 00 00 00 00 02 5B 7E
					15 01 00 00 00 00 02 5C 7E
					15 01 00 00 00 00 02 3C 00
					15 01 00 00 00 00 02 52 60
					15 01 00 00 00 00 02 56 5B
					15 01 00 00 00 00 02 5A 54
					15 01 00 00 00 00 02 54 56
					15 01 00 00 00 00 02 02 00
					15 01 00 00 00 00 02 03 84
					15 01 00 00 00 00 02 44 EF
					15 01 00 00 00 00 02 4E 3F
					15 01 00 00 00 00 02 20 13
					15 01 00 00 00 00 02 2A 13
					15 01 00 00 00 00 02 2B 08
					15 01 00 00 00 00 02 23 F7
					15 01 00 00 00 00 02 2D 54
					15 01 00 00 00 00 02 2E 74
					15 01 00 00 00 00 02 B5 54
					15 01 00 00 00 00 02 B7 74
					39 01 00 00 00 00 04 FF 78 07 06
					15 01 00 00 00 00 02 0A 0C
					15 01 00 00 00 00 02 0B AF
					15 01 00 00 00 00 02 0E 06
					15 01 00 00 00 00 02 D8 10
					15 01 00 00 00 00 02 48 35
					15 01 00 00 00 00 02 4D 08
					15 01 00 00 00 00 02 49 01
					39 01 00 00 00 00 04 FF 78 07 08
					39 01 00 00 00 00 29 E0 00 00 16 3E 00 5C 79 8F 00 A4 B7 C8 15 00 2C 6F 25 A2 EE 27 2A 29 65 A6 3E D0 05 2A 3F 52 60 6E 3F 7E 8F A4 3F BA D6 D9 
					39 01 00 00 00 00 29 E1 00 00 16 3E 00 5C 79 8F 00 A4 B7 C8 15 00 2C 6F 25 A2 EE 27 2A 29 65 A6 3E D0 05 2A 3F 52 60 6E 3F 7E 8F A4 3F BA D6 D9
					39 01 00 00 00 00 04 FF 78 07 0B
					15 01 00 00 00 00 02 94 88
					15 01 00 00 00 00 02 95 1F
					15 01 00 00 00 00 02 96 06
					15 01 00 00 00 00 02 97 06
					15 01 00 00 00 00 02 98 CB
					15 01 00 00 00 00 02 99 CB
					15 01 00 00 00 00 02 9A 06
					15 01 00 00 00 00 02 9B C6
					15 01 00 00 00 00 02 9C 05
					15 01 00 00 00 00 02 9D 05
					15 01 00 00 00 00 02 9E A9
					15 01 00 00 00 00 02 9F A9
					15 01 00 00 00 00 02 A7 62
					15 01 00 00 00 00 02 A8 02
					15 01 00 00 00 00 02 A9 FF
					15 01 00 00 00 00 02 AA 02
					15 01 00 00 00 00 02 AB F0
					15 01 00 00 00 00 02 AC 64
					15 01 00 00 00 00 02 AD 24
					15 01 00 00 00 00 02 AE 00
					39 01 00 00 00 00 04 FF 78 07 0E
					15 01 00 00 00 00 02 00 A3
					15 01 00 00 00 00 02 02 12
					15 01 00 00 00 00 02 13 02
					15 01 00 00 00 00 02 40 07
					15 01 00 00 00 00 02 49 2C
					15 01 00 00 00 00 02 47 90
					15 01 00 00 00 00 02 45 0A
					15 01 00 00 00 00 02 46 A6
					15 01 00 00 00 00 02 4D C3
					15 01 00 00 00 00 02 51 00
					15 01 00 00 00 00 02 B0 31
					15 01 00 00 00 00 02 B1 62
					15 01 00 00 00 00 02 B3 00
					15 01 00 00 00 00 02 B4 33
					15 01 00 00 00 00 02 BC 04
					15 01 00 00 00 00 02 BD FC
					15 01 00 00 00 00 02 C0 63
					15 01 00 00 00 00 02 C6 62
					15 01 00 00 00 00 02 C7 62
					15 01 00 00 00 00 02 C8 62
					15 01 00 00 00 00 02 C9 62
					15 01 00 00 00 00 02 D2 00
					15 01 00 00 00 00 02 D3 A8
					15 01 00 00 00 00 02 D4 00
					15 01 00 00 00 00 02 D5 A8
					15 01 00 00 00 00 02 D6 00
					15 01 00 00 00 00 02 D7 A8
					15 01 00 00 00 00 02 D8 00
					15 01 00 00 00 00 02 D9 A8
					15 01 00 00 00 00 02 E0 00
					15 01 00 00 00 00 02 E1 00
					15 01 00 00 00 00 02 E2 09
					15 01 00 00 00 00 02 E3 17
					15 01 00 00 00 00 02 E4 04
					15 01 00 00 00 00 02 E5 04
					15 01 00 00 00 00 02 E6 00
					15 01 00 00 00 00 02 E7 05
					15 01 00 00 00 00 02 E8 00
					15 01 00 00 00 00 02 E9 02
					15 01 00 00 00 00 02 EA 07
					39 01 00 00 00 00 04 FF 78 07 0E
					15 01 00 00 00 00 02 07 21
					15 01 00 00 00 00 02 4B 14
					39 01 00 00 00 00 04 FF 78 07 0C
					15 01 00 00 00 00 02 00 11
					15 01 00 00 00 00 02 01 17
					15 01 00 00 00 00 02 02 11
					15 01 00 00 00 00 02 03 1E
					15 01 00 00 00 00 02 04 12
					15 01 00 00 00 00 02 05 28
					15 01 00 00 00 00 02 06 11
					15 01 00 00 00 00 02 07 1C
					15 01 00 00 00 00 02 08 12
					15 01 00 00 00 00 02 09 21
					15 01 00 00 00 00 02 0A 11
					15 01 00 00 00 00 02 0B 20
					15 01 00 00 00 00 02 0C 12
					15 01 00 00 00 00 02 0D 22
					15 01 00 00 00 00 02 0E 11
					15 01 00 00 00 00 02 0F 15
					15 01 00 00 00 00 02 10 12
					15 01 00 00 00 00 02 11 26
					15 01 00 00 00 00 02 12 11
					15 01 00 00 00 00 02 13 1A
					15 01 00 00 00 00 02 14 12
					15 01 00 00 00 00 02 15 24
					15 01 00 00 00 00 02 16 11
					15 01 00 00 00 00 02 17 1B
					15 01 00 00 00 00 02 18 11
					15 01 00 00 00 00 02 19 19
					15 01 00 00 00 00 02 1A 12
					15 01 00 00 00 00 02 1B 27
					15 01 00 00 00 00 02 1C 11
					15 01 00 00 00 00 02 1D 1F
					15 01 00 00 00 00 02 1E 11
					15 01 00 00 00 00 02 1F 16
					15 01 00 00 00 00 02 20 11
					15 01 00 00 00 00 02 21 1D
					15 01 00 00 00 00 02 22 11
					15 01 00 00 00 00 02 23 18
					15 01 00 00 00 00 02 24 11
					15 01 00 00 00 00 02 25 14
					15 01 00 00 00 00 02 26 12
					15 01 00 00 00 00 02 27 25
					15 01 00 00 00 00 02 28 12
					15 01 00 00 00 00 02 29 23
					39 01 00 00 00 00 04 FF 78 07 00
					05 01 00 00 50 00 02 11 00
					05 01 00 00 14 00 02 29 00
					39 01 00 00 00 00 04 FF 78 07 0F
					];
				qcom,mdss-dsi-on-command-state = "dsi_lp_mode";
				qcom,mdss-dsi-off-command =
					[39 01 00 00 00 00 04 FF 78 07 00
					 05 01 00 00 14 00 02 28 00
					 05 01 00 00 78 00 02 10 00];
				qcom,mdss-dsi-off-command-state = "dsi_lp_mode";
			};
		};
	};
};
